## conf/local.conf
```bitbake
MACHINE = "raspberrypi4-64"
IMAGE_FSTYPES = "rpi-sdimg"
GPU_MEM = "16"
LICENSE_FLAGS_ACCEPTED = "commercial"
KERNEL_MODULE_AUTOLOAD += "uvcvideo videodev"
ENABLE_UART = "1"
IMAGE_INSTALL:append = " v4l-utils"
IMAGE_INSTALL:append = " gcc g++ make cmake git"
IMAGE_INSTALL:append = " libv4l v4l-utils"
IMAGE_INSTALL:append = " coreutils util-linux procps syslog-ng"
IMAGE_INSTALL:append = " strace gdb"
IMAGE_INSTALL:append = " rt-tests stress-ng htop"
IMAGE_FEATURES:append = " ssh-server-openssh"
IMAGE_FEATURES:append = " package-management"
IMAGE_FEATURES:append = " tools-debug"
IMAGE_FEATURES:append = " dev-pkgs tools-sdk"
IMAGE_ROOTFS_EXTRA_SPACE = "2097152"
BB_NUMBER_THREADS = "2"
PARALLEL_MAKE = "-j 2"
```
